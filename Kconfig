## Kconfig
```kconfig
mainmenu "QDNix configuration"

choice
	prompt "Architecture"
	default ARCH_ARM

config ARCH_ARM
	bool "ARM architecture"

config ARCH_ATHENA
	bool "Athena architecture"

config ARCH_RISCV64
	bool "RISC-V 64 architecture"

config ARCH_MIPS
	bool "MIPS architecture"

config ARCH_PDP11
	bool "PDP-11 architecture"

config ARCH_X86
	bool "x86 architecture"

endchoice

source "sys/Kconfig"
```

## make/Kconfig
```kconfig
choice
	prompt "Toolchain"
	default SDCC if ARCH_Z80
	default GNU if ARCH_ATHENA
	default LLVM

config GNU
	bool "GNU"
	depends on ARCH_ARM || ARCH_ATHENA || ARCH_RISCV64 || ARCH_MIPS || ARCH_PDP11

config LLVM
	bool "LLVM"
	depends on ARCH_ARM || ARCH_RISCV64 || ARCH_MIPS

config CC65
	bool "CC65"
	depends on ARCH_6502

config SDCC
	bool "SDCC"
	depends on ARCH_Z80

endchoice

config TOOLCHAIN
	string
	default "gnu" if GNU
	default "llvm" if LLVM
	default "cc65" if CC65
	default "sdcc" if SDCC

choice
	prompt "Build Type"
	default DEBUG

config DEBUG
	bool "Debug"

config RELEASE
	bool "Release"

endchoice

menu "Debug Build Configuration"
	depends on DEBUG 

config BUILD_TYPE
	string
	default "debug"

config UBSAN
	bool "build with UBSAN"
	default false
	depends on GNU || LLVM

endmenu

menu "Release Build Configuration"
	depends on RELEASE 

config BUILD_TYPE
	string
	default "release"

endmenu
```

## src/sys/arm/Kconfig
```kconfig
menu "ARM architecture"
	depends on CPU_ARM

config ARCH
	string
	default "arm"

endmenu
```

## src/sys/arm/board/nrf52dk/Kconfig
```kconfig
menu "nRF52 DK"
	depends on BOARD_NRF52DK

config SOC_NRF52832
	bool
	default y

config BOARD
	string
	default "nrf52dk"

endmenu
```

## src/sys/athena/Kconfig
```kconfig
menu "Athena architecture"
	depends on Athena

config ARCH
	string
	default "athena"

endmenu
```

## src/sys/mips/Kconfig
```kconfig
menu "MIPS architecture"
	depends on ARCH_MIPS

	config ARCH
		string
		default "mips"

	choice
		prompt "Board"
		default BOARD_MALTA

		config BOARD_MALTA
			bool "malta"

		config BOARD_MIPSSIM
			bool "mipssim"

	endchoice

	rsource "board/*/Kconfig"
endmenu
```

## src/sys/mips/board/mipssim/Kconfig
```kconfig
menu "MIPSsim"
	depends on BOARD_MIPSSIM

	config BOARD
		string
		default "mipssim"

endmenu
```

## src/sys/mips/malta/Kconfig
```kconfig
menu "Board config"
	depends on BOARD_MALTA

config SMP
	int
	default 4

endmenu
```

## src/sys/riscv/Kconfig
```kconfig
menu "RISC-V architecture"
	depends on ARCH_RISCV64

	config ARCH
		string
		default "riscv"

	config RV64
		bool "64bit"
		default true

	choice
		prompt "Board"
		default BOARD_QEMU

		config BOARD_QEMU
			bool "QEMU-virtio"

		config BOARD_LICHEE_RV
			bool "Sipeed Lichee RV"

	endchoice

	config M_MODE
		bool "Machine mode"
		default false

endmenu
```

## src/sys/riscv64/Kconfig
```kconfig
menu "RISC-V 64 architecture"
	depends on ARCH_RISCV64

	config ARCH
		string
		default "riscv64"

	choice
		prompt "Board"
		default BOARD_QEMU

		config BOARD_QEMU
			bool "QEMU-virtio"

		config BOARD_LICHEE_RV
			bool "Sipeed Lichee RV"

	endchoice

	config M_MODE
		bool "Machine mode"
		default false

endmenu
```

## src/sys/riscv64/board/virt/Kconfig
```kconfig
menu "QEMU-virtio"
	depends on BOARD_QEMU

config BOARD
	string
	default "virt"

endmenu
```

## src/sys/z80/Kconfig
```kconfig
menu "z80 architecture"
	depends on ARCH_Z80

	config ARCH
		string
		default "z80"

endmenu
```

## sys/arm/Kconfig
```kconfig
menu "ARM architecture"
	depends on ARCH_ARM

config ARCH
	string
	default "arm"

	choice
		prompt "Board"
		default BOARD_ORANGEPI_PC

		config  BOARD_ORANGEPI_PC
			bool "Orange Pi PC"

		config BOARD_NRF52DK
			bool "nRF52 DK"

	endchoice

	rsource "board/*/Kconfig"
	rsource "soc/*/Kconfig"

endmenu
```

## sys/arm/board/orangepi-pc/Kconfig
```kconfig
menu "Orange Pi PC"
	depends on BOARD_ORANGEPI_PC

config CPU_CORTEX_A7
	bool
	default y

config BOARD
	string
	default "orangepi-pc"

endmenu
```

## sys/arm/soc/cortex-a7/Kconfig
```kconfig
menu "Cortex-A7"
	depends on CPU_CORTEX_A7

config CPU
	string
	default "cortex-a7"

endmenu
```

## sys/ez80/Kconfig
```kconfig
menu "ez80 architecture"
	depends on ARCH_EZ80

	config ARCH
		string
		default "ez80"

endmenu
```

## sys/i386/Kconfig
```kconfig
menu "x86 architecture"
	depends on ARCH_X86

config ARCH
	string
	default "i386"

config BOARD
	string
	default "pc"

endmenu
```

## sys/kern/Kconfig
```kconfig
menu "Console"


config BUFFERED_CONSOLE
	bool "Buffered console"
	default y

config CONSOLE_BUFFER_SIZE
	int "Buffer size"
	depends on BUFFERED_CONSOLE
	default 512

endmenu
```

## sys/mips/board/malta/Kconfig
```kconfig
menu "MIPS Malta"
	depends on BOARD_MALTA

	config BOARD
		string
		default "malta"

	config SMP
		prompt "smp"
		int
		default 4

endmenu
```

## sys/pdp11/Kconfig
```kconfig
menu "PDP-11 architecture"
	depends on ARCH_PDP11

config ARCH
	string
	default "pdp11"

endmenu
```

## sys/sparc/Kconfig
```kconfig
menu "SPARC architecture"
	depends on ARCH_SPARC

	config ARCH
		string
		default "sparc"

	choice
		prompt "Board"
		default BOARD_LEON3

		config BOARD_LEON3
			bool "leon"

	endchoice
endmenu
```
