## tools/Kconfig
```kconfig
menu "Tools"

config BUILD_TOOLS
	bool "build tools"
	default y

config USE_TOOLS
	bool "use tools"
	default y

config TOOLS_PREFIX
	string "tools prefix"
	default "qdn-"

endmenu
```
